## SeparationHandover/zhouwei/交接文档/740_sensor文档/BMI120 sensor hal + driver/BSX4.0.0.28_Android_Generic_RC1b_20150122/Src/driver/IIO3.4/imu/bmi160/Kconfig
```kconfig
#
#Kconfig for BMI160 IIO Driver
#
config SENSORS_BMI160
	tristate "Bosch BMI160 IIO Driver"
	depends on I2C && SYSFS
	help
		If you say yes here you get support for Bosch Sensortec's
		sensor drivers of BMI160.
		
config SENSORS_BMI160_ENABLE_INT1
tristate "BMI160 sensor interrupt INT1 support"
depends on SENSORS_BMI160_IIO
	help
	 If you say yes here, you get INT1 support for Bosch Sensortec
	 sensors BMI160.

config SENSORS_BMI160_ENABLE_INT2
tristate "BMI160 sensor interrupt INT2 support"
depends on SENSORS_BMI160_IIO
	help
	 If you say yes here, you get INT2 support for Bosch Sensortec
	 sensors BMI160.

config BMI160_MAG_INTERFACE_SUPPORT
tristate "BMI160 Sensor mag interface support"
depends on SENSORS_BMI160_IIO
	help
	 If you say yes here, you get support for Bosch Sensortec's
	 sensor driver of BMI160 with mag sensor support.
config BMI160_DEBUG
tristate "BMI160 Sensor data debug"
depends on SENSORS_BMI160_IIO
	help
	 If you say yes here, you get support for Bosch Sensortec's
	 sensor data debug of BMI160.
```
